## components/guition_jc1060_bsp/Kconfig
```kconfig
# BSP configuration moved to Kconfig.projbuild
# This creates a top-level "Guition JC1060P470C Board Configuration" menu
# in menuconfig instead of being under "Component config"

menu "Graphics Configuration"
    
    config LVGL_USE_ESP_LVGL_PORT
        bool "Use esp_lvgl_port (recommended)"
        default y
        depends on BSP_ENABLE_LVGL
        help
          Use Espressif's official LVGL port package.
          Provides optimized display/touch integration, automatic
          tick management, and buffer allocation.

    config LVGL_ENABLE_PPA
        bool "Enable PPA (Pixel Processing Accelerator)"
        default y
        depends on BSP_ENABLE_LVGL
        select LVGL_PORT_ENABLE_PPA
        select LCD_RGB_ISR_IRAM_SAFE
        select LCD_RGB_RESTART_IN_VSYNC
        help
          Enable ESP32-P4 PPA hardware accelerator for:
          - Software rotation (90/180/270 degrees)
          - Scaling operations
          - Color format conversion
          - DMA2D accelerated transfers
          
          Also enables:
          - LCD ISR in IRAM for zero-latency interrupts
          - LCD restart synchronized with VSYNC
          
          Required for display rotation without performance penalty
          and smooth rendering without flicker.

    config LVGL_DOUBLE_BUFFER_PSRAM
        bool "Double buffering in PSRAM (required for 200MHz)"
        default y
        depends on BSP_ENABLE_LVGL
        help
          Use PSRAM (32MB @ 200MHz) for LVGL framebuffers.
          Required for smooth 1024x600 rendering without flicker.

    config LVGL_DISP_RES_X
        int "Display horizontal resolution"
        default 1024
        range 320 1920
        depends on BSP_ENABLE_LVGL
        help
          JD9165 display width

    config LVGL_DISP_RES_Y
        int "Display vertical resolution"
        default 600
        range 240 1080
        depends on BSP_ENABLE_LVGL
        help
          JD9165 display height

    choice LVGL_DISP_ROTATION
        prompt "Display rotation"
        default LVGL_DISP_ROTATION_0
        depends on BSP_ENABLE_LVGL && LVGL_ENABLE_PPA
        help
          Rotate display using PPA hardware acceleration

        config LVGL_DISP_ROTATION_0
            bool "0° (Landscape)"
        config LVGL_DISP_ROTATION_90
            bool "90° (Portrait)"
        config LVGL_DISP_ROTATION_180
            bool "180° (Landscape inverted)"
        config LVGL_DISP_ROTATION_270
            bool "270° (Portrait inverted)"
    endchoice

    config LVGL_DISP_ROTATION_DEGREES
        int
        default 0 if LVGL_DISP_ROTATION_0
        default 90 if LVGL_DISP_ROTATION_90
        default 180 if LVGL_DISP_ROTATION_180
        default 270 if LVGL_DISP_ROTATION_270

endmenu

menu "Radar Configuration"

    config BSP_RADAR_LD2410C_ENABLE
        bool "Enable HLK-LD2410C radar support"
        default y
        help
          Enable HLK-LD2410C radar integration through the official
          shyndman/esp32-ld2410 component.

    config BSP_RADAR_UART_PORT
        int "Radar UART port"
        default 2
        depends on BSP_RADAR_LD2410C_ENABLE

    config BSP_RADAR_RX_PIN
        int "Radar UART RX GPIO"
        default 32
        depends on BSP_RADAR_LD2410C_ENABLE

    config BSP_RADAR_TX_PIN
        int "Radar UART TX GPIO"
        default 33
        depends on BSP_RADAR_LD2410C_ENABLE

    config BSP_RADAR_OUT_PIN
        int "Radar OUT GPIO"
        default 4
        depends on BSP_RADAR_LD2410C_ENABLE

    config BSP_RADAR_SLEEP_WAKEUP
        bool "Enable deep sleep wakeup from radar OUT pin"
        default y
        depends on BSP_RADAR_LD2410C_ENABLE

    config BSP_RADAR_LOG_SILENT
        bool "Silence periodic radar sampling logs"
        default y
        depends on BSP_RADAR_LD2410C_ENABLE

endmenu
```
