## main/Kconfig.projbuild
```kconfig
menu "Guition Demo Configuration"

    choice LVGL_DEMO
        prompt "Select LVGL Demo"
        default LVGL_DEMO_SIMPLE_UI
        help
            Select which LVGL demo to run at startup.
            Only one demo can be active at a time.

        config LVGL_DEMO_SIMPLE_UI
            bool "Simple UI (Default)"
            help
                Basic LVGL demo with minimal UI elements.
                Good for verifying display and touch functionality.

        config LVGL_DEMO_HW_TEST
            bool "Hardware Test UI"
            help
                Interactive hardware test demo:
                - Center button (200x200) at exact center (512, 300)
                - Crosshair for touch visualization
                - Slider for value adjustment
                - Click counter button
                Useful for precise touch calibration and testing.

        config LVGL_DEMO_WIDGETS
            bool "Widgets Demo (LVGL Official)"
            depends on LV_USE_DEMO_WIDGETS
            help
                Official LVGL widgets showcase demo.
                Requires LV_USE_DEMO_WIDGETS=y in LVGL configuration.

    endchoice

endmenu
```

## sdkconfig.defaults
```kconfig
# Guition JC1060P470C - Base Configuration (All Chips)

# === BSP Configuration ===
CONFIG_BSP_ENABLE_DISPLAY=y
CONFIG_BSP_ENABLE_I2C=y
CONFIG_BSP_ENABLE_TOUCH=y
CONFIG_BSP_ENABLE_AUDIO=n
CONFIG_BSP_ENABLE_RTC=n
CONFIG_BSP_ENABLE_WIFI=n
CONFIG_BSP_ENABLE_SDCARD=n

# === LVGL Configuration ===
CONFIG_BSP_ENABLE_LVGL=y
# TEST: 200 lines = 1024x200 = 204,800 pixels (400 KB/buffer)
# This creates 3 stripes - if top stripe issue persists, it's not stripe count
CONFIG_BSP_LVGL_BUFFER_LINES=200
CONFIG_BSP_LVGL_DOUBLE_BUFFER=y
CONFIG_BSP_LVGL_USE_DMA_BUFFER=y
CONFIG_BSP_LVGL_USE_SPIRAM_BUFFER=n
CONFIG_BSP_LVGL_ENABLE_SW_ROTATE=n
CONFIG_BSP_LVGL_TOUCH_ENABLE=y
CONFIG_BSP_LVGL_ENABLE_DEMO=y
CONFIG_BSP_LVGL_DEMO_WIDGETS=y

# === System ===
CONFIG_IDF_TARGET="esp32p4"

# === Flash Configuration ===
CONFIG_ESPTOOLPY_FLASHMODE_QIO=y
CONFIG_ESPTOOLPY_FLASHSIZE_16MB=y
CONFIG_ESPTOOLPY_FLASHSIZE="16MB"
CONFIG_ESPTOOLPY_HEADER_FLASHSIZE_UPDATE=y
CONFIG_SPI_FLASH_BYPASS_BLOCK_ERASE_CHECK=y
CONFIG_SPI_FLASH_SUPPORT_BOYA_CHIP=y

# === Chip Revision ===
# Target ESP32-P4 v1.3 (revisions < 3.0)
CONFIG_ESP32P4_SELECTS_REV_LESS_V3=y
CONFIG_ESP32P4_REV_MIN_0=y
CONFIG_ESP_REV_MIN_FULL=103
CONFIG_ESP_REV_MIN=103

# === Partition Table ===
CONFIG_PARTITION_TABLE_CUSTOM=y
CONFIG_PARTITION_TABLE_CUSTOM_FILENAME="partitions.csv"
CONFIG_PARTITION_TABLE_FILENAME="partitions.csv"
CONFIG_PARTITION_TABLE_OFFSET=0xD000

# === PSRAM Configuration ===
# Board has 32MB octal PSRAM @ 200MHz
CONFIG_SPIRAM=y
CONFIG_SPIRAM_MODE_HEX=y
CONFIG_SPIRAM_SPEED_200M=y
CONFIG_SPIRAM_BOOT_INIT=y
CONFIG_SPIRAM_USE_MALLOC=y
CONFIG_SPIRAM_MALLOC_ALWAYSINTERNAL=16384
CONFIG_SPIRAM_TRY_ALLOCATE_WIFI_LWIP=y
# XIP (Execute In Place) from PSRAM for code optimization
CONFIG_SPIRAM_RODATA=y
CONFIG_SPIRAM_XIP_FROM_PSRAM=y

# === NVS ===
CONFIG_NVS_ENCRYPTION=n

# === Compiler Options ===
# Use performance optimization for display rendering (critical for MIPI DSI timing)
CONFIG_COMPILER_OPTIMIZATION_PERF=y

# === Stack Protection ===
CONFIG_COMPILER_STACK_CHECK_MODE_NORM=y
CONFIG_COMPILER_STACK_CHECK=y

# === Memory ===
CONFIG_ESP_DEFAULT_CPU_FREQ_MHZ_400=y
CONFIG_ESP_DEFAULT_CPU_FREQ_MHZ=400
CONFIG_ESP_MAIN_TASK_STACK_SIZE=10240

# === Cache Configuration ===
# Optimize cache for PSRAM framebuffer access
CONFIG_CACHE_L2_CACHE_256KB=y
CONFIG_CACHE_L2_CACHE_LINE_128B=y

# === FreeRTOS ===
CONFIG_FREERTOS_HZ=1000
CONFIG_FREERTOS_USE_TICKLESS_IDLE=n
CONFIG_FREERTOS_VTASKLIST_INCLUDE_COREID=y
CONFIG_FREERTOS_GENERATE_RUN_TIME_STATS=y
CONFIG_FREERTOS_ISR_STACKSIZE=2048

# === ESP System Settings ===
CONFIG_ESP_TASK_WDT_TIMEOUT_S=10
CONFIG_ESP_TASK_WDT_CHECK_IDLE_TASK_CPU0=n
CONFIG_ESP_TASK_WDT_CHECK_IDLE_TASK_CPU1=n

# === Panic & Crash Handling ===
CONFIG_ESP_SYSTEM_PANIC_PRINT_HALT=y
CONFIG_ESP_COREDUMP_TO_UART=y
CONFIG_ESP_COREDUMP_DATA_FORMAT_ELF=y
CONFIG_ESP_COREDUMP_CHECKSUM_CRC32=y

# === Logging ===
CONFIG_LOG_DEFAULT_LEVEL_INFO=y
CONFIG_LOG_DEFAULT_LEVEL=3
CONFIG_LOG_MAXIMUM_LEVEL_VERBOSE=y
CONFIG_LOG_MAXIMUM_LEVEL=5
CONFIG_LOG_COLORS=y

# === LCD/Display ===
CONFIG_LCD_RGB_ISR_IRAM_SAFE=y
CONFIG_LCD_RGB_RESTART_IN_VSYNC=y

# === LVGL v9 Performance Optimizations (CRITICAL) ===
# Hardware Acceleration
CONFIG_LVGL_PORT_ENABLE_PPA=y

# C Library Integration
CONFIG_LV_USE_CLIB_MALLOC=y
CONFIG_LV_USE_CLIB_STRING=y
CONFIG_LV_USE_CLIB_SPRINTF=y
CONFIG_LV_MEMCPY_MEMSET_STD=y

# Performance Settings
CONFIG_LV_DEF_REFR_PERIOD=15
CONFIG_LV_OS_FREERTOS=y

# CRITICAL: 2 draw units for parallel rendering (vendor config)
CONFIG_LV_DRAW_SW_DRAW_UNIT_CNT=2

# CRITICAL: Use IRAM for fast memory operations (vendor config)
CONFIG_LV_ATTRIBUTE_FAST_MEM_USE_IRAM=y

# Fonts
CONFIG_LV_FONT_MONTSERRAT_12=y
CONFIG_LV_FONT_MONTSERRAT_14=y
CONFIG_LV_FONT_MONTSERRAT_16=y
CONFIG_LV_FONT_MONTSERRAT_18=y
CONFIG_LV_FONT_MONTSERRAT_20=y
CONFIG_LV_FONT_MONTSERRAT_22=y
CONFIG_LV_FONT_MONTSERRAT_24=y
CONFIG_LV_FONT_MONTSERRAT_26=y
CONFIG_LV_FONT_MONTSERRAT_28=y
CONFIG_LV_FONT_MONTSERRAT_32=y
CONFIG_LV_USE_FONT_COMPRESSED=y

# Text
CONFIG_LV_TXT_BREAK_CHARS=" ,.;:-_"

# Monitoring
CONFIG_LV_USE_SYSMON=y
CONFIG_LV_USE_PERF_MONITOR=y

# Extensions
CONFIG_LV_USE_IMGFONT=y

# LVGL Demos - Enable Widgets Demo only
CONFIG_LV_USE_DEMO_WIDGETS=y

# LVGL Examples - Disable to reduce build size and time
CONFIG_LV_BUILD_EXAMPLES=n

# === GPIO Configuration ===
CONFIG_GPIO_ESP32_SUPPORT_SWITCH_SLP_PULL=y

# === I2C Configuration ===
CONFIG_I2C_ENABLE_DEBUG_LOG=n

# === Experimental Features ===
CONFIG_IDF_EXPERIMENTAL_FEATURES=y

# === Application Features ===
CONFIG_APP_ENABLE_NVS=y
```

## sdkconfig.defaults.esp32p4
```kconfig
# Guition JC1060P470C - ESP32-P4 Specific Configuration

# === CPU Configuration ===
CONFIG_ESP32P4_REV_MIN_0=y
CONFIG_ESP32P4_REV_MIN=0

# PSRAM and Cache settings are now managed by BSP Kconfig
# when CONFIG_BSP_ENABLE_DISPLAY_JD9165 is enabled

# === Memory Protection ===
CONFIG_ESP_SYSTEM_MEMPROT_FEATURE=y

# === USB Configuration ===
CONFIG_ESP_CONSOLE_USB_SERIAL_JTAG=y
CONFIG_ESP_CONSOLE_SECONDARY_NONE=y

# === MIPI DSI Configuration ===
CONFIG_LCD_MIPI_DSI_ENABLE=y
CONFIG_LCD_MIPI_DSI_DPI_CLK_SRC_DEFAULT=y

# === Performance Optimization ===
CONFIG_SPIRAM_FETCH_INSTRUCTIONS=y
CONFIG_SPIRAM_RODATA=y
```
